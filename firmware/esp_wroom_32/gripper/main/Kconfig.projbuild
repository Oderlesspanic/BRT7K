## firmware/esp_wroom_32/gripper/main/Kconfig.projbuild
```kconfig
menu "Gripper Configuration"

config GRIPPER_OPEN_GAP_MM
    int "Open gripper gap in millimeters"
    range 1 300
    default 80
    help
        Gap represented by the fully open arm encoder position.

config GRIPPER_CLOSED_GAP_MM
    int "Closed gripper gap in millimeters"
    range 0 300
    default 0
    help
        Gap represented by the fully closed arm encoder position.

endmenu
```
